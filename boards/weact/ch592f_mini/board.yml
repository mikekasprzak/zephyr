## boards/weact/ch592f_mini/board.yml
```yaml
board:
  name: ch592f_mini
  full_name: CH592F Mini BLE Core Board
  vendor: weact
  socs:
    - name: ch592f
```

## dts/bindings/cpu/wch,qingke-v2a.yaml
```yaml
# Copyright (c) 2024 Dhiru Kholia <dhiru.kholia@gmail.com>
# Copyright (c) 2025 MASSDRIVER EI (massdriver.space)
# Copyright (c) 2026 Mike Kasprzak (distraction.engineer)
# SPDX-License-Identifier: Apache-2.0

description: WCH QingKe V2A RISC-V MCU

compatible: "wch,qingke-v2a"

include: riscv,cpus.yaml
```

## dts/bindings/cpu/wch,qingke-v2c.yaml
```yaml
# Copyright (c) 2025 MASSDRIVER EI (massdriver.space)
# Copyright (c) 2026 Mike Kasprzak (distraction.engineer)
# SPDX-License-Identifier: Apache-2.0

description: WCH QingKe V2C RISC-V MCU

compatible: "wch,qingke-v2c"

include: riscv,cpus.yaml
```

## dts/bindings/cpu/wch,qingke-v3a.yaml
```yaml
# Copyright (c) 2025 MASSDRIVER EI (massdriver.space)
# Copyright (c) 2026 Mike Kasprzak (distraction.engineer)
# SPDX-License-Identifier: Apache-2.0

description: WCH QingKe V3A RISC-V MCU

compatible: "wch,qingke-v3a"

include: riscv,cpus.yaml
```

## dts/bindings/cpu/wch,qingke-v3b.yaml
```yaml
# Copyright (c) 2025 MASSDRIVER EI (massdriver.space)
# Copyright (c) 2026 Mike Kasprzak (distraction.engineer)
# SPDX-License-Identifier: Apache-2.0

description: WCH QingKe V3B RISC-V MCU

compatible: "wch,qingke-v3b"

include: riscv,cpus.yaml
```

## dts/bindings/cpu/wch,qingke-v3c.yaml
```yaml
# Copyright (c) 2025 MASSDRIVER EI (massdriver.space)
# Copyright (c) 2026 Mike Kasprzak (distraction.engineer)
# SPDX-License-Identifier: Apache-2.0

description: WCH QingKe V3C RISC-V MCU

compatible: "wch,qingke-v3c"

include: riscv,cpus.yaml
```

## dts/bindings/cpu/wch,qingke-v3f.yaml
```yaml
# Copyright (c) 2025 MASSDRIVER EI (massdriver.space)
# Copyright (c) 2026 Mike Kasprzak (distraction.engineer)
# SPDX-License-Identifier: Apache-2.0

description: WCH QingKe V3F RISC-V MCU

compatible: "wch,qingke-v3f"

include: riscv,cpus.yaml
```

## dts/bindings/cpu/wch,qingke-v4a.yaml
```yaml
# Copyright (c) 2025 MASSDRIVER EI (massdriver.space)
# Copyright (c) 2026 Mike Kasprzak (distraction.engineer)
# SPDX-License-Identifier: Apache-2.0

description: WCH QingKe V4A RISC-V MCU

compatible: "wch,qingke-v4a"

include: riscv,cpus.yaml
```

## dts/bindings/cpu/wch,qingke-v4j.yaml
```yaml
# Copyright (c) 2025 MASSDRIVER EI (massdriver.space)
# Copyright (c) 2026 Mike Kasprzak (distraction.engineer)
# SPDX-License-Identifier: Apache-2.0

description: WCH QingKe V4J RISC-V MCU

compatible: "wch,qingke-v4j"

include: riscv,cpus.yaml
```

## dts/bindings/cpu/wch,qingke-v5f.yaml
```yaml
# Copyright (c) 2025 MASSDRIVER EI (massdriver.space)
# Copyright (c) 2026 Mike Kasprzak (distraction.engineer)
# SPDX-License-Identifier: Apache-2.0

description: WCH QingKe V5F RISC-V MCU

compatible: "wch,qingke-v5f"

include: riscv,cpus.yaml
```

## soc/wch/ch32v/qingke_v4c/Kconfig.defconfig.ch592
```kconfig
# Copyright (c) 2026 Mike Kasprzak (distraction.engineer)
# SPDX-License-Identifier: Apache-2.0

if SOC_CH592

config VECTOR_TABLE_SIZE
	default 104

config NUM_IRQS
	default 128

endif # SOC_CH592
```

## soc/wch/ch32v/qingke_v4c/Kconfig.soc.ch591
```kconfig
# Copyright (c) 2026 Mike Kasprzak (distraction.engineer)
# SPDX-License-Identifier: Apache-2.0

config SOC_CH591
	bool
	select SOC_SERIES_QINGKE_V4C

config SOC_CH591F
	bool
	select SOC_CH591

config SOC_CH591D
	bool
	select SOC_CH591

config SOC_CH591R
	bool
	select SOC_CH591

config SOC
	default "ch591f" if SOC_CH591F
	default "ch591d" if SOC_CH591D
	default "ch591r" if SOC_CH591R
```

## soc/wch/ch32v/qingke_v4c/Kconfig.soc.ch592
```kconfig
# Copyright (c) 2026 Mike Kasprzak (distraction.engineer)
# SPDX-License-Identifier: Apache-2.0

config SOC_CH592
	bool
	select SOC_SERIES_QINGKE_V4C

config SOC_CH592X
	bool
	select SOC_CH592

config SOC_CH592F
	bool
	select SOC_CH592

config SOC_CH592A
	bool
	select SOC_CH592

config SOC_CH592D
	bool
	select SOC_CH592

config SOC
	default "ch592x" if SOC_CH592X
	default "ch592f" if SOC_CH592F
	default "ch592a" if SOC_CH592A
	default "ch592d" if SOC_CH592D
```

## soc/wch/ch32v/qingke_v4f/Kconfig.defconfig.ch32v307
```kconfig
# Copyright (c) 2025 Thomas Boje
# SPDX-License-Identifier: Apache-2.0

if SOC_CH32V307

config VECTOR_TABLE_SIZE
	default 103

config USE_VECTOR_TABLE_OFFSET
	default y

config NUM_IRQS
	default 128

endif # SOC_CH32V307
```
