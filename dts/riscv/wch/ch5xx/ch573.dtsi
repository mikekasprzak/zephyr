/*
 * Copyright (c) 2026 Mike Kasprzak (distraction.engineer)
 *
 * SPDX-License-Identifier: Apache-2.0
 */

#include <mem.h>

#define SOC_USER_SRAM		DT_SIZE_K(16)
#define SOC_USER_CODEFLASH	DT_SIZE_K(448)
#define SOC_USER_DATAFLASH	DT_SIZE_K(32)
#define SOC_SYS_SRAM		DT_SIZE_K(2)
#define SOC_SYS_BOOTLOADER	DT_SIZE_K(24)
#define SOC_SYS_INFOFLASH	DT_SIZE_K(8)

#define SOC_NGPIOA		8
#define SOC_NGPIOB		7
#define SOC_NGPIOC		8
#define SOC_NGPIOD		8

#include <wch/ch5xx/ch57x.dtsi>
