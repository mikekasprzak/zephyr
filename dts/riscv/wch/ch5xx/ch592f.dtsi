/*
 * Copyright (c) 2026 Mike Kasprzak (distraction.engineer)
 *
 * SPDX-License-Identifier: Apache-2.0
 */

#include "ch592.dtsi"

&gpioa {
	gpio-reserved-ranges = <7 1>;
};

&gpiob {
	gpio-reserved-ranges = <2 1>, <4 3>;
};

&gpioc {
	gpio-reserved-ranges = <3 1>, <6 2>;
};

&gpiod {};
